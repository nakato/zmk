## app/west.yml
```yaml
manifest:
  remotes:
    - name: zephyrproject-rtos
      url-base: https://github.com/zephyrproject-rtos
    - name: zmkfirmware
      url-base: https://github.com/zmkfirmware
    - name: nakato
      url-base: https://github.com/nakato
  projects:
    - name: zephyr
      remote: nakato
      revision: sparkfun_pro_micro_rp2040
      clone-depth: 1
      import:
        # TODO: Rename once upstream offers option like `exclude` or `denylist`
        name-blacklist:
          - ci-tools
          - hal_altera
          - hal_cypress
          - hal_infineon
          - hal_microchip
          - hal_nxp
          - hal_openisa
          - hal_silabs
          - hal_xtensa
          - hal_st
          - hal_ti
          - loramac-node
          - mcuboot
          - mcumgr
          - net-tools
          - openthread
          - edtt
          - trusted-firmware-m
          - sof
    - name: zephyr-pro-micro-rp2040
      remote: nakato
      revision: main
      path: modules/boards/zephyr-pro-micro-rp2040

  self:
    west-commands: scripts/west-commands.yml
```
